## examples/linux/buildroot/Config.in
```kconfig
source "$BR2_EXTERNAL_GOLIOTH_BUILDROOT_PATH/package/golioth-firmware-sdk/Config.in"
source "$BR2_EXTERNAL_GOLIOTH_BUILDROOT_PATH/package/golioth-app/Config.in"
```

## examples/linux/buildroot/configs/qemu_aarch64_golioth_defconfig
```kconfig
# Architecture - ARM64 for better performance on Apple Silicon
BR2_aarch64=y

# Build optimization - Cache downloads to speed up builds
BR2_DL_DIR="$(BR2_EXTERNAL_GOLIOTH_BUILDROOT_PATH)/dl"
BR2_PER_PACKAGE_DIRECTORIES=y

# External Toolchain - Use Bootlin toolchain for better reliability
BR2_TOOLCHAIN_EXTERNAL=y
BR2_TOOLCHAIN_EXTERNAL_BOOTLIN=y
BR2_TOOLCHAIN_EXTERNAL_BOOTLIN_AARCH64_GLIBC_STABLE=y

# System
BR2_SYSTEM_DHCP="eth0"
BR2_TARGET_GENERIC_HOSTNAME="golioth-qemu"
BR2_TARGET_GENERIC_ISSUE="Welcome to Golioth QEMU (ARM64)"
BR2_ROOTFS_OVERLAY="$(BR2_EXTERNAL_GOLIOTH_BUILDROOT_PATH)/board/qemu/aarch64-golioth/rootfs_overlay"
BR2_ROOTFS_POST_BUILD_SCRIPT="$(BR2_EXTERNAL_GOLIOTH_BUILDROOT_PATH)/board/qemu/aarch64-golioth/post-build.sh"
BR2_ROOTFS_POST_IMAGE_SCRIPT="$(BR2_EXTERNAL_GOLIOTH_BUILDROOT_PATH)/board/qemu/aarch64-golioth/post-image.sh"

# Kernel
BR2_LINUX_KERNEL=y
BR2_LINUX_KERNEL_CUSTOM_VERSION=y
BR2_LINUX_KERNEL_CUSTOM_VERSION_VALUE="6.6.51"
BR2_LINUX_KERNEL_USE_ARCH_DEFAULT_CONFIG=y
BR2_LINUX_KERNEL_CONFIG_FRAGMENT_FILES="$(BR2_EXTERNAL_GOLIOTH_BUILDROOT_PATH)/board/qemu/aarch64-golioth/linux.fragment"
BR2_LINUX_KERNEL_NEEDS_HOST_OPENSSL=y

# Filesystem
BR2_TARGET_ROOTFS_EXT2=y
BR2_TARGET_ROOTFS_EXT2_4=y
BR2_TARGET_ROOTFS_EXT2_SIZE="120M"

# Bootloader - Use U-Boot for ARM64
BR2_TARGET_UBOOT=y
BR2_TARGET_UBOOT_BOARDNAME="qemu_arm64"
BR2_TARGET_UBOOT_CUSTOM_VERSION=y
BR2_TARGET_UBOOT_CUSTOM_VERSION_VALUE="2024.01"
BR2_TARGET_UBOOT_FORMAT_BIN=y
BR2_TARGET_UBOOT_NEEDS_MBEDTLS=y
BR2_TARGET_UBOOT_NEEDS_OPENSSL=y

# Network packages
BR2_PACKAGE_DHCPCD=y
BR2_PACKAGE_DROPBEAR=y
BR2_PACKAGE_WGET=y
BR2_PACKAGE_CA_CERTIFICATES=y

# Crypto libraries - Include both for build compatibility
BR2_PACKAGE_MBEDTLS=y
BR2_PACKAGE_LIBOPENSSL=y
BR2_PACKAGE_OPENSSL=y

# Development tools
BR2_PACKAGE_STRACE=y
BR2_PACKAGE_GDB=y

# Logging support - Enable BusyBox syslog tools
BR2_PACKAGE_BUSYBOX_SHOW_OTHERS=y

# Update packages - swupdate for A/B OTA updates
BR2_PACKAGE_SWUPDATE=y
BR2_PACKAGE_SWUPDATE_LUA=y
BR2_PACKAGE_SWUPDATE_CONFIG_JSON=y
BR2_PACKAGE_SWUPDATE_CONFIG_LIBRSYNC=y
BR2_PACKAGE_UBOOT_TOOLS=y
BR2_PACKAGE_UBOOT_TOOLS_FWPRINTENV=y

# Golioth packages
BR2_PACKAGE_GOLIOTH_FIRMWARE_SDK=y
BR2_PACKAGE_GOLIOTH_APP=y

# Host tools
BR2_PACKAGE_HOST_QEMU=y
BR2_PACKAGE_HOST_QEMU_SYSTEM_MODE=y
BR2_PACKAGE_HOST_MBEDTLS=y
BR2_PACKAGE_HOST_LIBOPENSSL=y
```

## examples/linux/buildroot/configs/qemu_x86_64_golioth_defconfig
```kconfig
# Architecture
BR2_x86_64=y

# Build optimization - Cache downloads to speed up builds
BR2_DL_DIR="$(BR2_EXTERNAL_GOLIOTH_BUILDROOT_PATH)/dl"
BR2_PER_PACKAGE_DIRECTORIES=y

# External Toolchain - Use Bootlin prebuilt toolchain for faster builds
BR2_TOOLCHAIN_EXTERNAL=y
BR2_TOOLCHAIN_EXTERNAL_BOOTLIN=y
BR2_TOOLCHAIN_EXTERNAL_BOOTLIN_X86_64_CORE_I7_GLIBC_STABLE=y

# System
BR2_SYSTEM_DHCP="eth0"
BR2_TARGET_GENERIC_HOSTNAME="golioth-qemu"
BR2_TARGET_GENERIC_ISSUE="Welcome to Golioth QEMU"
BR2_ROOTFS_OVERLAY="$(BR2_EXTERNAL_GOLIOTH_BUILDROOT_PATH)/board/qemu/x86_64-golioth/rootfs_overlay"
BR2_ROOTFS_POST_BUILD_SCRIPT="$(BR2_EXTERNAL_GOLIOTH_BUILDROOT_PATH)/board/qemu/x86_64-golioth/post-build.sh"

# Kernel
BR2_LINUX_KERNEL=y
BR2_LINUX_KERNEL_CUSTOM_VERSION=y
BR2_LINUX_KERNEL_CUSTOM_VERSION_VALUE="6.6.51"
BR2_LINUX_KERNEL_USE_ARCH_DEFAULT_CONFIG=y
BR2_LINUX_KERNEL_CONFIG_FRAGMENT_FILES="$(BR2_EXTERNAL_GOLIOTH_BUILDROOT_PATH)/board/qemu/x86_64-golioth/linux.fragment"
BR2_LINUX_KERNEL_NEEDS_HOST_OPENSSL=y

# Filesystem
BR2_TARGET_ROOTFS_EXT2=y
BR2_TARGET_ROOTFS_EXT2_4=y
BR2_TARGET_ROOTFS_EXT2_SIZE="120M"

# Bootloader
BR2_TARGET_GRUB2=y
BR2_TARGET_GRUB2_X86_64_EFI=y

# Network packages
BR2_PACKAGE_DHCPCD=y
BR2_PACKAGE_OPENSSH=y
BR2_PACKAGE_WGET=y
BR2_PACKAGE_CA_CERTIFICATES=y

# Development tools
BR2_PACKAGE_STRACE=y
BR2_PACKAGE_GDB=y

# Golioth packages
BR2_PACKAGE_GOLIOTH_FIRMWARE_SDK=y
BR2_PACKAGE_GOLIOTH_APP=y

# Host tools
BR2_PACKAGE_HOST_QEMU=y
BR2_PACKAGE_HOST_QEMU_SYSTEM_MODE=y
```

## examples/linux/buildroot/package/golioth-app/Config.in
```kconfig
config BR2_PACKAGE_GOLIOTH_APP
	bool "golioth-app"
	depends on BR2_PACKAGE_GOLIOTH_FIRMWARE_SDK
	help
	  Golioth application demonstrating core SDK features including
	  LightDB State, Stream, Logging, OTA, RPC, and Settings.

	  This self-contained application connects to the Golioth IoT cloud
	  and demonstrates the full functionality of the Golioth Firmware SDK.

comment "golioth-app needs golioth-firmware-sdk"
	depends on !BR2_PACKAGE_GOLIOTH_FIRMWARE_SDK
```

## examples/linux/buildroot/package/golioth-basics/Config.in
```kconfig
config BR2_PACKAGE_GOLIOTH_BASICS
	bool "golioth-basics"
	depends on BR2_PACKAGE_GOLIOTH_FIRMWARE_SDK
	help
	  Golioth basics example application demonstrating core SDK features
	  including LightDB State, Stream, Logging, OTA, RPC, and Settings.

	  This example connects to the Golioth IoT cloud and demonstrates
	  the basic functionality of the Golioth Firmware SDK.

comment "golioth-basics needs golioth-firmware-sdk"
	depends on !BR2_PACKAGE_GOLIOTH_FIRMWARE_SDK
```

## examples/linux/buildroot/package/golioth-firmware-sdk/Config.in
```kconfig
config BR2_PACKAGE_GOLIOTH_FIRMWARE_SDK
	bool "golioth-firmware-sdk"
	depends on BR2_INSTALL_LIBSTDCPP
	depends on BR2_USE_WCHAR
	depends on BR2_TOOLCHAIN_HAS_THREADS
	depends on !BR2_STATIC_LIBS
	select BR2_PACKAGE_OPENSSL
	select BR2_PACKAGE_ZLIB
	help
	  Golioth Firmware SDK for connecting embedded devices to the
	  Golioth IoT cloud platform.

	  https://github.com/golioth/golioth-firmware-sdk

comment "golioth-firmware-sdk needs a toolchain w/ C++, wchar, threads, dynamic library"
	depends on !BR2_INSTALL_LIBSTDCPP || !BR2_USE_WCHAR || \
		!BR2_TOOLCHAIN_HAS_THREADS || BR2_STATIC_LIBS
```
